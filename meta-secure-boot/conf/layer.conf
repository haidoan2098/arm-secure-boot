## scripts/fit-image.its
```
/dts-v1/;

/ {
    description = "FIT image for BeagleBone Black - kernel + dtb";

    images {
        kernel-1 {
            description = "Linux kernel";
            data = /incbin/("zImage");
            type = "kernel";
            arch = "arm";
            os = "linux";
            compression = "none";
            load = <0x80008000>;
            entry = <0x80008000>;
            hash-1 { algo = "sha256"; };
        };

        fdt-1 {
            description = "Device Tree Blob";
            data = /incbin/("am335x-boneblack.dtb");
            type = "flat_dt";
            arch = "arm";
            compression = "none";
            load = <0x88000000>;
            hash-1 { algo = "sha256"; };
        };
    };

    configurations {
        default = "conf-1";

        conf-1 {
            description = "BeagleBone Black boot config";
            kernel = "kernel-1";
            fdt = "fdt-1";
            signature-1 {
                algo = "sha256,rsa2048";
                key-name-hint = "dev";
                sign-images = "kernel", "fdt";
            };
        };
    };
};
```
